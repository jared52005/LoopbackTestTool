## LTT.Test.ESP32S3/sdkconfig.defaults
```kconfig
#
# Enable BT Stack
#
CONFIG_BT_ENABLED=y
CONFIG_BTDM_CTRL_MODE_BLE_ONLY=y
CONFIG_BTDM_CTRL_MODE_BR_EDR_ONLY=n
CONFIG_BTDM_CTRL_MODE_BTDM=n

#
# ESP32-specific config
#
CONFIG_ESP32_ENABLE_STACK_BT=y
# CONFIG_ESP32_ENABLE_STACK_NONE is not set
CONFIG_MEMMAP_BT=y

#
# ESP32 HTTP server interface (for Websockets)
#
CONFIG_HTTPD_WS_SUPPORT=y

#
# ESP32-S3 USB interface
#
CONFIG_TINYUSB=y
CONFIG_TINYUSB_CDC_ENABLED=y
```
